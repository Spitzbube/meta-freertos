## conf/machine/include/tune-arm7tdmi.inc
```bitbake
#DEFAULTTUNE ?= "armv4t"
#DEFAULTTUNE ?= "armv4t"

require conf/machine/include/arm/arch-armv4.inc

TUNEVALID[arm7tdmi] = "Enable arm7tdmi specific processor optimizations"
TUNE_CCARGS .= "${@bb.utils.contains('TUNE_FEATURES', 'arm7tdmi', ' -mcpu=arm7tdmi', '', d)}"
MACHINEOVERRIDES =. "${@bb.utils.contains('TUNE_FEATURES', 'arm7tdmi', 'armv4:', '' ,d)}"

AVAILTUNES += "arm7tdmi"
ARMPKGARCH_tune-arm7tdmi = "arm7tdmi"
# mcpu is used so don't use armv4t as we don't want march
#TUNE_FEATURES_tune-arm7tdmi = "arm thumb arm7tdmi"
TUNE_FEATURES_tune-arm7tdmi = "arm arm7tdmi"
#PACKAGE_EXTRA_ARCHS_tune-arm7tdmi = "${PACKAGE_EXTRA_ARCHS_tune-armv4t} arm7tdmit"
PACKAGE_EXTRA_ARCHS_tune-arm7tdmi = "${PACKAGE_EXTRA_ARCHS_tune-armv4} arm7tdmi"
```

## conf/machine/lpc-p2148.conf
```bitbake
#@TYPE: Machine
#@NAME: lpc-p2148

#@DESCRIPTION: Machine configuration for Olimex LPC-P2148 Board.

ARM_INSTRUCTION_SET = "thumb"
THUMB_INTERWORK = "yes"

require conf/machine/include/tune-arm7tdmi.inc
```

## conf/machine/stm32-p405.conf
```bitbake
#@TYPE: Machine
#@NAME: stm32-p405

#@DESCRIPTION: Machine configuration for Olimex STM32-P405 Board.

require conf/machine/include/tune-cortexm4.inc
```

## conf/machine/vistron-vdr-400.conf
```bitbake
#@TYPE: Machine
#@NAME: vistron-vdr-400

#@DESCRIPTION: Machine configuration for Vistron VDR 400 Board.

require conf/machine/include/tune-cortexm3.inc
```
